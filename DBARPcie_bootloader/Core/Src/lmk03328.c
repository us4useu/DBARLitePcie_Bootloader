/*
 * lmk03328.c
 *
 *  Created on: May 15, 2023
 *      Author: JR
 */

#include "lmk03328.h"

I2C_HandleTypeDef lmk_hi2c;

//default LMK03328 config
const uint8_t lmk_conf[LMK_REGS_SZ] = {
		0x10, 0x0b, 0x00, 0x06, 0xd0, 0x5b, 0x00, 0x00, 0x00, 0x00, 0x00, 0x00, 0xd1, 0x00, 0x00, 0x00,
		0x00, 0x00, 0x00, 0x00, 0xff, 0xff, 0xff, 0x02, 0x00, 0x75, 0x00, 0x28, 0x58, 0x84, 0x38, 0x80,
		0x00, 0x0c, 0xa0, 0x20, 0x13, 0x7c, 0x19, 0x40, 0x33, 0x00, 0x27, 0x00, 0x19, 0x0a, 0x00, 0x00,
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		0x00, 0x00, 0x40, 0x24, 0x00,
};

void lmk03328_enable() {
	HAL_GPIO_WritePin(CLK_PDN_GPIO_Port, CLK_PDN_Pin, GPIO_PIN_SET);
}

void lmk03328_disable() {
	HAL_GPIO_WritePin(CLK_PDN_GPIO_Port, CLK_PDN_Pin, GPIO_PIN_RESET);

}

void lmk03328_init(I2C_HandleTypeDef *hi2c){
	lmk_hi2c = *hi2c;

	for(uint8_t n = 0; n < (LMK_REGS_SZ - 3); n++) {
		lmk03328_write(n, lmk_conf[n]);
	}

	lmk03328_write(169, lmk_conf[146]);
	lmk03328_write(172, lmk_conf[147]);
	lmk03328_write(173, lmk_conf[148]);
}

void lmk03328_write(uint8_t reg, uint8_t value){
	HAL_StatusTypeDef st;
	uint8_t tx_buf[2] = {reg, value};
	st = HAL_I2C_Master_Transmit(&lmk_hi2c, LMK_ADDR<<1, tx_buf, 2, 1000);
	if(st != HAL_OK) {
		printf("LMK03328 I2C Write Error!\n");
	}
}

uint8_t lmk03328_read(uint8_t reg) {
	uint8_t rx;
	HAL_StatusTypeDef st;
	st = HAL_I2C_Master_Transmit(&lmk_hi2c, LMK_ADDR<<1, &reg, 1, 1000);
	st = HAL_I2C_Master_Receive(&lmk_hi2c, LMK_ADDR<<1, &rx, 1, 1000);
	if(st != HAL_OK) {
		printf("LMK03328 I2C Read Error!\n");
	}
	return rx;
}

